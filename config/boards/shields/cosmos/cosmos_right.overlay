#include "cosmos.dtsi"

&default_transform { // Offset of 7 because the left side has 7 columns
	col-offset = <7>;
};

&kscan0 {
	row-gpios
		// = <&gpio0 20 (GPIO_ACTIVE_HIGH | GPIO_PULL_DOWN)> // The 020 pin got damaged.
		= <&gpio0 17 (GPIO_ACTIVE_HIGH | GPIO_PULL_DOWN)>
		, <&gpio0 22 (GPIO_ACTIVE_HIGH | GPIO_PULL_DOWN)>
		, <&gpio0 24 (GPIO_ACTIVE_HIGH | GPIO_PULL_DOWN)>
		, <&gpio1 0 (GPIO_ACTIVE_HIGH | GPIO_PULL_DOWN)>
		, <&gpio0 11 (GPIO_ACTIVE_HIGH | GPIO_PULL_DOWN)>
		, <&gpio1 4 (GPIO_ACTIVE_HIGH | GPIO_PULL_DOWN)>
		, <&gpio1 6 (GPIO_ACTIVE_HIGH | GPIO_PULL_DOWN)>
		;

	col-gpios
		= <&gpio0 9 (GPIO_ACTIVE_HIGH)>
		, <&gpio0 10 (GPIO_ACTIVE_HIGH)>
		, <&gpio1 11 (GPIO_ACTIVE_HIGH)>
		, <&gpio1 13 (GPIO_ACTIVE_HIGH)>
		, <&gpio1 15 (GPIO_ACTIVE_HIGH)>
		, <&gpio0 02 (GPIO_ACTIVE_HIGH)>
		, <&gpio0 29 (GPIO_ACTIVE_HIGH)> 
		;
};
