## config/boards/shields/cosmos/Kconfig.defconfig
```kconfig
if SHIELD_COSMOS_LEFT

config ZMK_KEYBOARD_NAME
	default "Cosmos"

config ZMK_SPLIT_ROLE_CENTRAL
	default y

endif

if SHIELD_COSMOS_LEFT || SHIELD_COSMOS_RIGHT

config ZMK_SPLIT
	default y

endif
```
